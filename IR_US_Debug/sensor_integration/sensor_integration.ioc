# file: sensor_integration.ioc
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Mcu.Family=STM32F0
Mcu.Name=STM32F072R(8-B)Tx
Mcu.Package=LQFP64
ProjectManager.HeapSize=0x200
ProjectManager.StackSize=0x400
ProjectManager.TargetToolchain=MDK-ARM V5
board=custom

// file: Core/Src/main.c
/* USER CODE BEGIN Header */
/**
  ******************************************************************************
  * @file           : main.c
  * @brief          : Main program body
  ******************************************************************************
  * @attention
  *
  * Copyright (c) 2023 STMicroelectronics.
  * All rights reserved.
  *
  * This software is licensed under terms that can be found in the LICENSE file
  * in the root directory of this software component.
  * If no LICENSE file comes with this software, it is provided AS-IS.
  *
  ******************************************************************************
  */
/* USER CODE END Header */
#include "main.h"
#include "distance_front.h"
#include "BT_usart.h"
#include "color_sensor_set.h"
#include "i3g_IR.h"

void SystemClock_Config(void);
static void MX_GPIO_Init(void);

void LED_Init(void){
	RCC -> AHBENR |= RCC_AHBENR_GPIOCEN;
	//Configuring red, blue, orange, and green LEDs to Output mode
	GPIOC -> MODER &= ~((1<<19) | (1<<18) | (1<<17) | (1<<16) | (1<<15) | (1<<14) | (1<<13) | (1<<12));
	GPIOC -> MODER |= (1<<18) | (1<<16) | (1<<14) | (1<<12);

	//Setting red, blue, orange, and green LEDs to no pull up or pull down mode
	GPIOC -> PUPDR &= ~((1<<19) | (1<<18) | (1<<17) | (1<<16) | (1<<15) | (1<<14) | (1<<13) | (1<<12));

	//Setting red, blue, orange, and green LEDs to low speed
	GPIOC -> OSPEEDR &= ~((1<<19) | (1<<18) | (1<<17) |(1<<16) | (1<<15) | (1<<14) | (1<<13) | (1<<12));

}

int main(void)
{

  /* MCU Configuration--------------------------------------------------------*/

  /* Reset of all peripherals, Initializes the Flash interface and the Systick. */
  HAL_Init();

  /* Configure the system clock */
  SystemClock_Config();

  /* Initialize all configured peripherals */
  MX_GPIO_Init();
  /* USER CODE BEGIN 2 */
	USART3_Init();
	BT_usart_init();
	LED_Init();
  color_sensor_init();

  /* USER CODE END 2 */
	char* message_start = "start";
	char* message_errror = "Error";
	char* message_newCMD = "New Command:";
	char* newline = "\n";
	BT_usart_transmit_message(message_start);
	BT_usart_transmit_message(newline);
	int dist = 0;
	uint8_t bytes[2];
	char buffer[20];
	char* Str = "";

	int a = 1253;
	int opCode = 0;
  /* Infinite loop */
  while (1)
  {
		BT_usart_transmit_message(message_newCMD);
		BT_usart_transmit_message(newline);

		opCode = BT_usart_receive_char();

		if (opCode == '1'){ // Sonar Distance Sensor
			int distraw=0;
			distraw = Sonar_GetDistance();
			Str = itoa(distraw, buffer, 10);
			BT_usart_transmit_message(Str);
			BT_usart_transmit_message(newline);

		} else if (opCode == '2'){  // Color sensor
			int colorRaw=0;
			colorRaw = getColor();
			Str = itoa(colorRaw, buffer, 10);
			BT_usart_transmit_message(Str);
			BT_usart_transmit_message(newline);

		} else if (opCode == '3'){	//Ir sensor 1
			int distraw=0;
			//Str = itoa(distraw, buffer, 10);
			BT_usart_transmit_message("Left: ");
			//BT_usart_transmit_message(Str);
			BT_usart_transmit_message(newline);

			//distraw = ir_2_getDist();
			//Str = itoa(distraw, buffer, 10);
			BT_usart_transmit_message("Right: ");
			//BT_usart_transmit_message(Str);
			BT_usart_transmit_message(newline);
		} else{
			BT_usart_transmit_message(message_errror);
			BT_usart_transmit_message(newline);
		}

		HAL_Delay(1000);
  }
}

void SystemClock_Config(void)
{
  RCC_OscInitTypeDef RCC_OscInitStruct = {0};
  RCC_ClkInitTypeDef RCC_ClkInitStruct = {0};

  /** Initializes the RCC Oscillators according to the specified parameters
  * in the RCC_OscInitTypeDef structure.
  */
  RCC_OscInitStruct.OscillatorType = RCC_OSCILLATORTYPE_HSI|RCC_OSCILLATORTYPE_HSI14;
  RCC_OscInitStruct.HSIState = RCC_HSI_ON;
  RCC_OscInitStruct.HSI14State = RCC_HSI14_ON;
  RCC_OscInitStruct.HSICalibrationValue = RCC_HSICALIBRATION_DEFAULT;
  RCC_OscInitStruct.HSI14CalibrationValue = 16;
  RCC_OscInitStruct.PLL.PLLState = RCC_PLL_NONE;
  if (HAL_RCC_OscConfig(&RCC_OscInitStruct) != HAL_OK)
  {
    Error_Handler();
  }
  /** Initializes the CPU, AHB and APB buses clocks
  */
  RCC_ClkInitStruct.ClockType = RCC_CLOCKTYPE_HCLK|RCC_CLOCKTYPE_SYSCLK
                              |RCC_CLOCKTYPE_PCLK1;
  RCC_ClkInitStruct.SYSCLKSource = RCC_SYSCLKSOURCE_HSI;
  RCC_ClkInitStruct.AHBCLKDivider = RCC_SYSCLK_DIV1;
  RCC_ClkInitStruct.APB1CLKDivider = RCC_HCLK_DIV1;

  if (HAL_RCC_ClockConfig(&RCC_ClkInitStruct, FLASH_LATENCY_0) != HAL_OK)
  {
    Error_Handler();
  }
}

static void MX_GPIO_Init(void)
{

  /* GPIO Ports Clock Enable */
  __HAL_RCC_GPIOC_CLK_ENABLE();

}

void Error_Handler(void)
{
  __disable_irq();
  while (1)
  {
  }
}
